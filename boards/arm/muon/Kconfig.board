## boards/arm/muon/Kconfig.board
```kconfig
# Copyright (c) 2024 Brandon Beltran
# SPDX-License-Identifier: MIT

config BOARD_MUON
    bool "muon"
    depends on SOC_NRF52833_QIAA
```

## boards/arm/muon/Kconfig.defconfig
```kconfig
# Copyright (c) 2024 Brandon Beltran
# SPDX-License-Identifier: MIT

if BOARD_MUON

config ZMK_KEYBOARD_NAME
    default "muon"

if USB_DEVICE_STACK

config USB_NRFX
    default y

endif # USB_DEVICE_STACK

config BT_CTLR
    default BT

endif # BOARD_MUON
```
